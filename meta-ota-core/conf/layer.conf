## meta-ota-core/conf/layer.conf
```bitbake
# We have a conf and classes directory, add to BBPATH
BBPATH .= ":${LAYERDIR}"

# We have recipes-* directories, add to BBFILES
BBFILES += "${LAYERDIR}/recipes-*/*/*.bb \
            ${LAYERDIR}/recipes-*/*/*.bbappend"

BBFILE_COLLECTIONS += "ota-core"
BBFILE_PATTERN_ota-core = "^${LAYERDIR}/"
BBFILE_PRIORITY_ota-core = "10"

LAYERSERIES_COMPAT_ota-core = "sumo"
```

## meta-ota-raspberrypi/conf/layer.conf
```bitbake
# We have a conf and classes directory, add to BBPATH
BBPATH .= ":${LAYERDIR}"

# We have recipes-* directories, add to BBFILES
BBFILES += "${LAYERDIR}/recipes-*/*/*.bb \
            ${LAYERDIR}/recipes-*/*/*.bbappend"

BBFILE_COLLECTIONS += "ota-raspberrypi"
BBFILE_PATTERN_ota-raspberrypi = "^${LAYERDIR}/"
BBFILE_PRIORITY_ota-raspberrypi = "10"

LAYERSERIES_COMPAT_ota-raspberrypi = "sumo"
```
